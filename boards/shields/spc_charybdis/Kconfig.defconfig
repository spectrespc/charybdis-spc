## boards/shields/spc_charybdis/Kconfig.defconfig
```kconfig
if SHIELD_SPC_CHARYBDIS_LEFT

# Name must be less than 16 characters long!
config ZMK_KEYBOARD_NAME
    default "spc-charybdis"

config ZMK_SPLIT_ROLE_CENTRAL
    default y

config ZMK_SPLIT_BLE_CENTRAL_PERIPHERALS
  default 1

config BT_MAX_CONN
  default 6

config BT_MAX_PAIRED
  default 6

endif

if SHIELD_SPC_CHARYBDIS_LEFT || SHIELD_SPC_CHARYBDIS_RIGHT

config ZMK_SPLIT
    default y

config ZMK_POINTING
    default y

endif

if SHIELD_SPC_CHARYBDIS_DONGLE

# Name must be less than 16 characters long!
config ZMK_KEYBOARD_NAME
    default "spc-charybdis"

config ZMK_POINTING
    default y

config ZMK_SPLIT
    default y

config ZMK_SPLIT_ROLE_CENTRAL
    default y

config ZMK_SPLIT_BLE_CENTRAL_PERIPHERALS
  default 2

config BT_MAX_CONN
  default 7

config BT_MAX_PAIRED
  default 7

endif

# ---------------------
# Kconfig for shield "spc_charybdis_left" with board "nice_nano_v2"
# ---------------------
if BOARD_NICE_NANO_V2 && SHIELD_SPC_CHARYBDIS_LEFT

config SPI
    default y

#config PMW3610
#    default y

config PMW3610_ALT
    default y

config ZMK_MOUSE
    default y

config ZMK_EXT_POWER
    default y

endif
```

## boards/shields/spc_charybdis/Kconfig.shield
```kconfig
config SHIELD_SPC_CHARYBDIS_LEFT
    def_bool $(shields_list_contains,spc_charybdis_left)
  
config SHIELD_SPC_CHARYBDIS_RIGHT
    def_bool $(shields_list_contains,spc_charybdis_right)
  
```
